VERSION ""

NS_ :

BS_:

BU_:

BO_ 1185 REF_Estercamento: 8 Vector__XXX
 SG_ Ref_Estercamento_Atuador : 0|32@1- (1,0) [0|255] "" Vector__XXX

CM_ BO_ 1185 "Referencia Estercamento Atuador.";
SIG_VALTYPE_ 1185 Ref_Estercamento_Atuador : 1;
